## kernel/Kconfig.rros
```kconfig
# Rros real-time core
config HAVE_ARCH_RROS
	bool

menuconfig Rros
	bool "BUPT real-time core"
	depends on HAVE_ARCH_RROS
	select DOVETAIL
	select DEVTMPFS
	help

	  The Rros core is a real-time component of the Linux kernel,
	  which delivers very short and bounded response time to
	  interrupt and task events.  Rros runs asynchronously to the
	  common kernel services, on the high-priority, out-of-band
	  stage managed by the Dovetail layer.
```

## kernel/Kconfig.rros_spinlock
```kconfig
config RROS_SPINLOCK
    bool "Enable RROS Spinlock"
    depends on RROS
    help
      Enable spinlock functionality for RROS. This option provides a
      specialized spinlock mechanism designed for the Rust Real-time Core.

      Note: This option is experimental and should only be enabled if
      you understand the implications on system performance.
```

## kernel/rros/Kconfig
```kconfig
# SPDX-License-Identifier: GPL-2.0-only

config RROS_OOB_NET
	bool "Out-of-band networking (EXPERIMENTAL)"
	default n
	select NET_OOB
	select NET_SCHED
	select NET_SCH_OOB
	select INET
	select VLAN_8021Q
	help
		This option enables preliminary networking support for Rros.

menuconfig RROS_TEST
	bool "Open the test point of RROS"
	default n
	depends on Rros
	help
		Let the test code test whether RROS works properly when the system
		starts. Turning on this CONFIG will slow down the startup.

if RROS_TEST
	source "kernel/rros/Kconfig.rros_test"
endif
```

## kernel/rros/Kconfig.rros_test
```kconfig
# SPDX-License-Identifier: GPL-2.0-only

config RROS_SMP_TEST
    bool "SMP test"
	default n
	help
	    Test the SMP function of RROS.

config RROS_TIMER_TEST
    bool "Timer test"
    default n
    help
        Test whether the timer in RROS is functioning properly.

config RROS_DOUBLE_LINKED_LIST
    bool "Double linked list test"
    default n
    help
        Test whether the double linked list in RROS is functioning properly.

config RROS_CLOCK_TEST
    bool "Clock test"
    default n
    help
        Test whether the clock in RROS is functioning properly.

config RROS_THREAD_TEST
    bool "Thread test"
    default n
    help
        Test whether the thread in RROS is functioning properly.

config RROS_WAIT_TEST
    bool "RrosWaitQueue test"
    default n
    help
        Test whether the wait queue in RROS is functioning properly.

config RROS_MEM_TEST
    bool "Memory test"
    default n
    help
        Test whether the memory management in RROS is functioning properly.

config RROS_LATENCY_TEST
    bool "Latency test"
    default n
    help
        Test the latmus of RROS.
```
